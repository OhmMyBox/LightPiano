/*
  Έργο: Φωτεινό Πιάνο (Light Piano)
  Μήνας: 1 (Εισαγωγή στα Κυκλώματα)
  Περιγραφή: Ένα απλό πιάνο που χρησιμοποιεί 4 κουμπιά, 4 LED και ένα Piezo Buzzer.
             Πατώντας ένα κουμπί ανάβει το αντίστοιχο LED και παίζει μια νότα.

  Διαμόρφωση Κυκλώματος (Wiring):
  - Κουμπιά: Pins 3, 4, 5, 6 (Συνδέονται στο 5V όταν πατηθούν)
  - LED:     Pins 8, 9, 10, 11 (Θετικό σκέλος στο pin, Αρνητικό στη Γείωση/GND μέσω αντίστασης 220Ω)
  - Buzzer:  Pin 12 (Θετικό σκέλος στο pin, Αρνητικό στη Γείωση/GND)

  Σημείωση: Χρησιμοποιούμε INPUT_PULLUP για τα κουμπιά. Αυτό σημαίνει ότι η λογική HIGH (1)
            είναι "πατημένο" και η λογική LOW (0) είναι "μη πατημένο".
*/

// --- ΣΤΑΘΕΡΕΣ & ΟΡΙΣΜΟΙ ---

// Ορισμός των συχνοτήτων για τις νότες μας (Κλίμακα Ντο Ματζόρε: C4, D4, E4, F4, G4)
// Μπορείτε να αλλάξετε αυτούς τους αριθμούς για να αλλάξετε τον τόνο!
#define NOTE_C4  262
#define NOTE_D4  294
#define NOTE_E4  330
#define NOTE_F4  349

// Ορισμοί Pin
const int BUZZER_PIN = 12;

// Οι πίνακες (arrays) για την αποθήκευση των αριθμών pin κάνουν τον κώδικα πιο καθαρό
const int ledPins[] = {3, 4, 5, 6};
const int buttonPins[] = {8, 9, 10, 11};

// Πίνακας για την αντιστοίχιση των νοτών σε κάθε κουμπί
const int notes[]      = {NOTE_C4, NOTE_D4, NOTE_E4, NOTE_F4};

// Υπολογισμός αριθμού πλήκτρων με βάση το μέγεθος του πίνακα (θα πρέπει να είναι 5)
const int numKeys = 4;

void setup() {
  // --- Η SETUP ΕΚΤΕΛΕΙΤΑΙ ΜΙΑ ΦΟΡΑ ---
  
  // Ρύθμιση του Buzzer
  pinMode(BUZZER_PIN, OUTPUT);

  // Ρύθμιση Κουμπιών και LED χρησιμοποιώντας βρόχο (loop)
  for (int i = 0; i < numKeys; i++) {
    // Τα κουμπιά χρησιμοποιούν εσωτερικές αντιστάσεις pull-up.
    // Αυτό απλοποιεί την καλωδίωση: συνδέστε απλά Κουμπί -> Pin και Κουμπί -> Γείωση (GND).
    pinMode(buttonPins[i], INPUT_PULLUP);
    
    // Τα LED είναι τυπικές έξοδοι (outputs)
    pinMode(ledPins[i], OUTPUT);
  }
  
  // Γρήγορος έλεγχος ήχου κατά την εκκίνηση (Προαιρετικό: Παίζει μια κλίμακα προς τα πάνω)
  //playStartupSound();
}

void loop() {
  // --- Η LOOP ΕΚΤΕΛΕΙΤΑΙ ΓΙΑ ΠΑΝΤΑ ---
  
  bool keyIsPressed = false; // Σημαία (Flag) για να παρακολουθούμε αν ΚΑΠΟΙΟ πλήκτρο είναι πατημένο

  // Έλεγχος κάθε κουμπιού για να δούμε αν είναι πατημένο
  for (int i = 0; i < numKeys; i++) {
    
    // Ανάγνωση της κατάστασης του κουμπιού. 
    // HIGH σημαίνει πατημένο επειδή χρησιμοποιούμε INPUT_PULLUP και συνδέουμε στο 5V.
    if (digitalRead(buttonPins[i]) == HIGH) {
      
      // 1. Άναμμα του συγκεκριμένου LED
      digitalWrite(ledPins[i], HIGH);
      
      // 2. Αναπαραγωγή της συγκεκριμένης νότας
      tone(BUZZER_PIN, notes[i]);
      
      // Σημειώνουμε ότι βρήκαμε πατημένο πλήκτρο
      keyIsPressed = true;
      
    } else {
      // Αν αυτό το συγκεκριμένο κουμπί ΔΕΝ είναι πατημένο, βεβαιωθείτε ότι το LED του είναι σβηστό
      digitalWrite(ledPins[i], LOW);
    }
  }

  // Αν ΚΑΝΕΝΑ πλήκτρο δεν πατήθηκε κατά τη διάρκεια αυτού του βρόχου, σίγαση του buzzer
  if (!keyIsPressed) {
    noTone(BUZZER_PIN);
    digitalWrite(BUZZER_PIN, HIGH);
  }
  
  
  // Μια μικρή καθυστέρηση βοηθά στη σταθερότητα
  delay(10);
}

// --- ΒΟΗΘΗΤΙΚΕΣ ΣΥΝΑΡΤΗΣΕΙΣ ---

void playStartupSound() {
  // Αναβοσβήνει τα LED και παίζει νότες γρήγορα για να δείξει ότι το σύστημα είναι έτοιμο
  for (int i = 0; i < numKeys; i++) {
    digitalWrite(ledPins[i], HIGH);
    tone(BUZZER_PIN, notes[i], 100); // Παίζει για 100ms
    delay(100);
    digitalWrite(ledPins[i], LOW);
  }
  noTone(BUZZER_PIN);
}
